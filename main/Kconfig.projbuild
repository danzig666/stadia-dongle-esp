## main/Kconfig.projbuild
```kconfig
menu "Stadia dongle"

    menu "Dongle status RGB LED"

        config DONGLE_LED_ENABLED
            bool "Enable status RGB LED"
            default y
            help
                Enable the low-priority status LED task. Disable this for boards
                without an RGB LED or if GPIO 48 is used for other hardware.

        choice DONGLE_LED_TYPE
            prompt "Status LED type"
            depends on DONGLE_LED_ENABLED
            default DONGLE_LED_TYPE_ADDRESSABLE

            config DONGLE_LED_TYPE_ADDRESSABLE
                bool "Single addressable RGB LED (WS2812/SK6812-style)"

            config DONGLE_LED_TYPE_NOOP
                bool "No-op"
        endchoice

        config DONGLE_LED_GPIO
            int "Addressable RGB LED GPIO"
            depends on DONGLE_LED_ENABLED && DONGLE_LED_TYPE_ADDRESSABLE
            default 48
            range 0 48
            help
                GPIO used by the board's addressable RGB LED. Many ESP32-S3
                dev boards use GPIO 48.

        config DONGLE_LED_BRIGHTNESS
            int "Status LED brightness"
            depends on DONGLE_LED_ENABLED
            default 32
            range 1 255
            help
                Global RGB brightness scalar. 32 is intentionally conservative
                for small onboard LEDs.

    endmenu

endmenu
```

## sdkconfig.defaults
```kconfig
CONFIG_IDF_TARGET="esp32s3"

# BLE — NimBLE only (no Bluedroid)
CONFIG_BT_ENABLED=y
CONFIG_BT_NIMBLE_ENABLED=y
CONFIG_BT_BLUEDROID_ENABLED=n
CONFIG_BT_NIMBLE_ROLE_CENTRAL=y
CONFIG_BT_NIMBLE_ROLE_PERIPHERAL=n
CONFIG_BT_NIMBLE_SECURITY_ENABLE=y
CONFIG_BT_NIMBLE_NVS_PERSIST=y
CONFIG_BT_NIMBLE_MAX_CONNECTIONS=1
CONFIG_BT_NIMBLE_HOST_TASK_STACK_SIZE=4096

# TinyUSB — custom Xbox 360 class driver (xbox_dev.c)
CONFIG_TINYUSB_ENABLED=y
CONFIG_TINYUSB_VENDOR_COUNT=0

# FreeRTOS
CONFIG_FREERTOS_HZ=1000
CONFIG_FREERTOS_UNICORE=n

# Logging — silence all output in production to minimise UART interrupt overhead
CONFIG_LOG_DEFAULT_LEVEL_NONE=y
CONFIG_LOG_DEFAULT_LEVEL=0

# CPU
CONFIG_ESP32S3_DEFAULT_CPU_FREQ_240=y
```

## sdkconfig.defaults.4mb
```kconfig
CONFIG_IDF_TARGET="esp32s3"

# BLE — NimBLE only (no Bluedroid)
CONFIG_BT_ENABLED=y
CONFIG_BT_NIMBLE_ENABLED=y
CONFIG_BT_BLUEDROID_ENABLED=n
CONFIG_BT_NIMBLE_ROLE_CENTRAL=y
CONFIG_BT_NIMBLE_ROLE_PERIPHERAL=n
CONFIG_BT_NIMBLE_SECURITY_ENABLE=y
CONFIG_BT_NIMBLE_NVS_PERSIST=y
CONFIG_BT_NIMBLE_MAX_CONNECTIONS=2
CONFIG_BT_NIMBLE_MAX_CCCDS=16
CONFIG_BT_NIMBLE_MAX_BONDS=4
CONFIG_BT_NIMBLE_HOST_TASK_STACK_SIZE=4096

# TinyUSB — custom Xbox 360 class driver (xbox_dev.c)
CONFIG_TINYUSB_ENABLED=y
CONFIG_TINYUSB_VENDOR_COUNT=0
CONFIG_TINYUSB_HID_COUNT=1
CONFIG_TINYUSB_SUSPEND_CALLBACK=y
CONFIG_TINYUSB_RESUME_CALLBACK=y

# FreeRTOS
CONFIG_FREERTOS_HZ=1000
CONFIG_FREERTOS_UNICORE=n

# Logging — silence all output in production to minimise UART interrupt overhead
CONFIG_LOG_DEFAULT_LEVEL_NONE=y
CONFIG_LOG_DEFAULT_LEVEL=0

# CPU
CONFIG_ESP32S3_DEFAULT_CPU_FREQ_240=y

# 4 MB flash with 2 × ~1.92 MB OTA slots
CONFIG_ESPTOOLPY_FLASHSIZE_4MB=y
CONFIG_ESPTOOLPY_FLASHSIZE="4MB"

# OTA updates from the local Web UI require a two-slot partition table.
CONFIG_PARTITION_TABLE_CUSTOM=y
CONFIG_PARTITION_TABLE_CUSTOM_FILENAME="partitions_4mb.csv"
CONFIG_PARTITION_TABLE_FILENAME="partitions_4mb.csv"
```
